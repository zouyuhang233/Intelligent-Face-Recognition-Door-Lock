#include "lcd.h"
#include <string.h>

/* ============ 16x8 ASCII 字库 ============ */
static const uint8_t ASCII_1608[][16] = {
    {0x00,0x00,0x00,0x00,0x00,0x00,0x00,0x00,0x00,0x00,0x00,0x00,0x00,0x00,0x00,0x00},
    {0x00,0x00,0x18,0x3C,0x3C,0x3C,0x18,0x18,0x18,0x00,0x18,0x18,0x00,0x00,0x00,0x00},
    {0x00,0x66,0x66,0x66,0x24,0x00,0x00,0x00,0x00,0x00,0x00,0x00,0x00,0x00,0x00,0x00},
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    {0x00,0x00,0x00,0x00,0x00,0xFE,0xCC,0x18,0x30,0x60,0xC6,0xFE,0x00,0x00,0x00,0x00}, // 'z'
};

/* ============ 内部函数 ============ */
static void LcdWriteReg(uint16_t reg)
{
    LCD_W_REG = reg;
}

static void LcdWriteData(uint16_t dat)
{
    LCD_W_DAT = dat;
}

/* ============ ST7796 初始化 ============ */
void LCD_Init(void)
{
    // 0x11 - Sleep Out
    LcdWriteReg(0x11);
    HAL_Delay(120);

    // 0x36 - MADCTL (横屏)
    LcdWriteReg(0x36);
    LcdWriteData(0x48);

    // 0x3A - 像素格式 16bit
    LcdWriteReg(0x3A);
    LcdWriteData(0x55);

    // 0xF0 - Command2 Enable
    LcdWriteReg(0xF0);
    LcdWriteData(0xC3);
    LcdWriteReg(0xF0);
    LcdWriteData(0x96);

    // 0xB4 - Display Inversion Control
    LcdWriteReg(0xB4);
    LcdWriteData(0x01);

    // 0xB6 - Display Function Control
    LcdWriteReg(0xB6);
    LcdWriteData(0x0A);
    LcdWriteData(0xA2);

    // 0xB7 - Entry Mode Set
    LcdWriteReg(0xB7);
    LcdWriteData(0xC6);

    // 0xB9
    LcdWriteReg(0xB9);
    LcdWriteData(0x02);
    LcdWriteData(0xE0);

    // 0xC0 - Power Control 1
    LcdWriteReg(0xC0);
    LcdWriteData(0x80);
    LcdWriteData(0x16);

    // 0xC1 - Power Control 2
    LcdWriteReg(0xC1);
    LcdWriteData(0x19);

    // 0xC2 - Power Control 3
    LcdWriteReg(0xC2);
    LcdWriteData(0xA7);

    // 0xC5 - VCOM Control
    LcdWriteReg(0xC5);
    LcdWriteData(0x16);

    // 0xE8 - Display Output Ctrl
    LcdWriteReg(0xE8);
    LcdWriteData(0x40);
    LcdWriteData(0x8A);
    LcdWriteData(0x00);
    LcdWriteData(0x00);
    LcdWriteData(0x29);
    LcdWriteData(0x19);
    LcdWriteData(0xA5);
    LcdWriteData(0x33);

    // 0xE0 - Positive Gamma（完全复制 Drive 项目）
    LcdWriteReg(0xE0);
    LcdWriteData(0xF0);
    LcdWriteData(0x07);
    LcdWriteData(0x0D);
    LcdWriteData(0x04);
    LcdWriteData(0x05);
    LcdWriteData(0x14);
    LcdWriteData(0x36);
    LcdWriteData(0x54);
    LcdWriteData(0x4C);
    LcdWriteData(0x38);
    LcdWriteData(0x13);
    LcdWriteData(0x14);
    LcdWriteData(0x2E);
    LcdWriteData(0x34);

    // 0xE1 - Negative Gamma（完全复制 Drive 项目）
    LcdWriteReg(0xE1);
    LcdWriteData(0xF0);
    LcdWriteData(0x10);
    LcdWriteData(0x14);
    LcdWriteData(0x0E);
    LcdWriteData(0x0C);
    LcdWriteData(0x08);
    LcdWriteData(0x35);
    LcdWriteData(0x44);
    LcdWriteData(0x4C);
    LcdWriteData(0x26);
    LcdWriteData(0x10);
    LcdWriteData(0x12);
    LcdWriteData(0x2C);
    LcdWriteData(0x32);

    // 0xF0 - Command2 Disable
    LcdWriteReg(0xF0);
    LcdWriteData(0x3C);
    LcdWriteReg(0xF0);
    LcdWriteData(0x69);

    HAL_Delay(120);

    // 0x21 - Display Inversion On
    LcdWriteReg(0x21);

    // 0x29 - Display On
    LcdWriteReg(0x29);

    // 0x36 - MADCTL 竖屏 BGR
    LcdWriteReg(0x36);
    LcdWriteData(0x08);

    // 清屏白色
    LCD_Clear(WHITE);

    // 开背光 (PB0)
    HAL_GPIO_WritePin(LCD_BL_GPIO_Port, LCD_BL_Pin, GPIO_PIN_SET);
}

/* ============ 设置窗口 ============ */
void LCD_SetWindow(uint16_t x0, uint16_t y0, uint16_t x1, uint16_t y1)
{
    LcdWriteReg(0x2A);
    LcdWriteData(x0 >> 8);
    LcdWriteData(x0 & 0xFF);
    LcdWriteData(x1 >> 8);
    LcdWriteData(x1 & 0xFF);

    LcdWriteReg(0x2B);
    LcdWriteData(y0 >> 8);
    LcdWriteData(y0 & 0xFF);
    LcdWriteData(y1 >> 8);
    LcdWriteData(y1 & 0xFF);

    LcdWriteReg(0x2C);
}

/* ============ 清屏 ============ */
void LCD_Clear(uint16_t color)
{
    LCD_SetWindow(0, 0, LCD_WIDTH - 1, LCD_HEIGHT - 1);
    for (uint32_t i = 0; i < (uint32_t)LCD_WIDTH * LCD_HEIGHT; i++)
        LcdWriteData(color);
}

/* ============ 画点 ============ */
void LCD_DrawPoint(uint16_t x, uint16_t y, uint16_t color)
{
    LCD_SetWindow(x, y, x, y);
    LcdWriteData(color);
}

/* ============ 填充矩形 ============ */
void LCD_FillRect(uint16_t x0, uint16_t y0, uint16_t x1, uint16_t y1, uint16_t color)
{
    LCD_SetWindow(x0, y0, x1, y1);
    for (uint32_t i = 0; i < (uint32_t)(x1 - x0 + 1) * (y1 - y0 + 1); i++)
        LcdWriteData(color);
}

/* ============ 显示字符 ============ */
void LCD_ShowChar(uint16_t x, uint16_t y, char ch, uint16_t color, uint16_t bgcolor)
{
    uint8_t idx = ch - ' ';
    if (idx > 95) idx = 0;

    uint8_t *p = (uint8_t *)ASCII_1608[idx];

    for (uint8_t i = 0; i < 16; i++)
    {
        uint8_t dat = p[i];
        for (uint8_t j = 0; j < 8; j++)
        {
            if (dat & 0x80)
                LCD_DrawPoint(x + j, y + i, color);
            else
                LCD_DrawPoint(x + j, y + i, bgcolor);
            dat <<= 1;
        }
    }
}

/* ============ 显示字符串 ============ */
void LCD_ShowString(uint16_t x, uint16_t y, const char *str, uint16_t color, uint16_t bgcolor)
{
    while (*str)
    {
        LCD_ShowChar(x, y, *str, color, bgcolor);
        x += 8;
        if (x > LCD_WIDTH - 8)
        {
            x = 0;
            y += 16;
        }
        str++;
    }
}
